/**
 * @file display_oled.c
 * @brief 1.3寸 I2C OLED 显示屏驱动 (SH1106 128x64)
 *
 * SH1106 与 SSD1306 不兼容，不能用 esp_lcd 框架。
 * 本驱动直接通过 I2C 发送命令和数据。
 *
 * 引脚: SDA→GPIO8, SCL→GPIO9
 * I2C 地址: 0x3C（SA0=GND）或 0x3D（SA0=VCC）
 */

#include <stdio.h>
#include <string.h>
#include "freertos/FreeRTOS.h"
#include "freertos/task.h"
#include "esp_log.h"
#include "driver/i2c_master.h"

#include "display_oled.h"

static const char *TAG = "OLED";

#define I2C_SDA  GPIO_NUM_8
#define I2C_SCL  GPIO_NUM_9
#define I2C_FREQ 400000
#define OLED_ADDR 0x3C   /* 默认，扫描失败时可改为 0x3D */

#define WIDTH  128
#define HEIGHT 64
#define PAGES  (HEIGHT / 8)   /* 8 */

static i2c_master_bus_handle_t s_bus = NULL;
static i2c_master_dev_handle_t s_dev = NULL;
static uint8_t s_framebuf[WIDTH * PAGES];  /* 128 x 8 = 1024 字节 */

/* ========== 8x8 ASCII 字体（与之前相同） ========== */
static const uint8_t s_font8x8[][8] __attribute__((unused)) = {
    {0x00,0x00,0x00,0x00,0x00,0x00,0x00,0x00},
    {0x00,0x00,0x00,0x5F,0x00,0x00,0x00,0x00},
    {0x00,0x00,0x07,0x00,0x07,0x00,0x00,0x00},
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    {0x44,0x64,0x54,0x4C,0x44,0x00,0x00,0x00},
};

/* ========== 表情位图数据（24x24 像素，共 5 种表情） ========== */

#define FACE_W 32
#define FACE_H 24


/* 笑脸 😊 */
static const uint8_t s_face_smile[] = {
    0x00,0x00,0x80,0xE0,0xF0,0xF8,0x7C,0x3C,0x1E,0x0E,0x0E,0x0E,
    0x8E,0x8E,0x0E,0x0E,0x8E,0x8E,0x0E,0x1E,0x3C,0x7C,0xF8,0xF0,
    0xE0,0x80,0x00,0x00,0x00,0x00,0x00,0x00,0x00,0x00,0x0F,0x3F,
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    0x01,0x01,0x00,0x00,0x00,0x00,0x00,0x00,0x00,0x00,0x00,0x00,
};
/* 悲伤 🙁 */
static const uint8_t s_face_sad[] = {
    0x00,0x00,0x80,0xE0,0xF0,0xF8,0x7C,0x3C,0x1E,0x0E,0x0E,0x0E,
    0x8E,0x8E,0x0E,0x0E,0x8E,0x8E,0x0E,0x1E,0x3C,0x7C,0xF8,0xF0,
    0xE0,0x80,0x00,0x00,0x00,0x00,0x00,0x00,0x00,0x00,0x07,0x1F,
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    0x00,0x00,0x00,0x00,0x00,0x00,0x00,0x00,0x00,0x00,0x00,0x00,
};
/* 眨眼 😉 */
static const uint8_t s_face_wink[] = {
    0x00,0x00,0x80,0xE0,0xF0,0xF8,0x7C,0x3C,0x1E,0x0E,0x0E,0x0E,
    0x8E,0x8E,0x0E,0x0E,0x0E,0x0E,0x0E,0x1E,0x3C,0xFC,0xF8,0xF0,
    0xE0,0x00,0x00,0x00,0x00,0x00,0x00,0x00,0x00,0x00,0x0F,0x3F,
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    0x01,0x01,0x00,0x00,0x00,0x00,0x00,0x00,0x00,0x00,0x00,0x00,
};
/* 惊讶 😮 */
static const uint8_t s_face_surprise[] = {
    0x00,0x00,0x80,0xE0,0xF0,0xF8,0x7C,0x3C,0x1E,0x0E,0x0E,0x8E,
    0x8E,0x8E,0x8E,0x8E,0x8E,0x0E,0x0E,0x1E,0x3C,0x7C,0xF8,0xF0,
    0xE0,0x80,0x00,0x00,0x00,0x00,0x00,0x00,0x00,0x00,0x0F,0x3F,
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    0x01,0x01,0x00,0x00,0x00,0x00,0x00,0x00,0x00,0x00,0x00,0x00,
};
/* 中性 😐 */
static const uint8_t s_face_neutral[] = {
    0x00,0x00,0x80,0xE0,0xF0,0xF8,0x7C,0x3C,0x1E,0x0E,0x0E,0x0E,
    0x8E,0x8E,0x0E,0x0E,0x8E,0x8E,0x0E,0x1E,0x3C,0x7C,0xF8,0xF0,
    0xE0,0x80,0x00,0x00,0x00,0x00,0x00,0x00,0x00,0x00,0x0F,0x3F,
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    0x01,0x01,0x00,0x00,0x00,0x00,0x00,0x00,0x00,0x00,0x00,0x00,
};

static const uint8_t *const s_faces[] __attribute__((unused)) = {
    s_face_smile, s_face_sad, s_face_wink, s_face_surprise, s_face_neutral,
};

/* ========== 大表情位图数据（64x64 像素 = 512 字节/个） ========== */
#include "face_big_data.inc"
static const uint8_t *const s_bigfaces[] = {
    s_bigface_smile, s_bigface_laugh, s_bigface_sad, s_bigface_wink, s_bigface_surprise,
};
#define BIGFACE_W 128
#define BIGFACE_H 64

/* ========== I2C 写命令/数据 ========== */

static esp_err_t write_cmd(uint8_t cmd)
{
    uint8_t buf[2] = {0x00, cmd};  /* 0x00 = command byte */
    return i2c_master_transmit(s_dev, buf, 2, -1);
}

static esp_err_t write_data(const uint8_t *data, size_t len)
{
    size_t total = 1 + len;
    uint8_t *buf = malloc(total);
    if (!buf) return ESP_ERR_NO_MEM;
    buf[0] = 0x40;  /* 0x40 = data byte */
    memcpy(buf + 1, data, len);
    esp_err_t ret = i2c_master_transmit(s_dev, buf, total, -1);
    free(buf);
    return ret;
}

/* ========== 初始化 ========== */

esp_err_t display_init(void)
{
    ESP_LOGI(TAG, "Init SH1106 128x64 (SDA:GPIO8, SCL:GPIO9)...");

    /* 创建 I2C 主机总线 */
    i2c_master_bus_config_t bus_cfg = {
        .i2c_port = -1,
        .sda_io_num = I2C_SDA,
        .scl_io_num = I2C_SCL,
        .clk_source = I2C_CLK_SRC_DEFAULT,
        .glitch_ignore_cnt = 7,
        .flags.enable_internal_pullup = true,
    };
    ESP_ERROR_CHECK(i2c_new_master_bus(&bus_cfg, &s_bus));

    /* 添加 I2C 设备 */
    i2c_device_config_t dev_cfg = {
        .dev_addr_length = I2C_ADDR_BIT_LEN_7,
        .device_address = OLED_ADDR,
        .scl_speed_hz = I2C_FREQ,
    };
    esp_err_t ret = i2c_master_bus_add_device(s_bus, &dev_cfg, &s_dev);
    if (ret != ESP_OK) {
        ESP_LOGE(TAG, "I2C device add failed (addr=0x%02X): 0x%x", OLED_ADDR, ret);
        ESP_LOGE(TAG, "Try address 0x3D, or check wiring/pull-ups");
        return ret;
    }

    /* 探测设备 */
    ret = i2c_master_probe(s_bus, OLED_ADDR, 100);
    if (ret != ESP_OK) {
        ESP_LOGE(TAG, "No response from 0x%02X — wrong address or wiring?", OLED_ADDR);
        return ret;
    }
    ESP_LOGI(TAG, "SH1106 found at 0x%02X", OLED_ADDR);

    /* === SH1106 初始化序列 === */
    vTaskDelay(pdMS_TO_TICKS(10));

    write_cmd(0xAE);       // display off
    write_cmd(0xD5);       // set osc freq
    write_cmd(0x80);
    write_cmd(0xA8);       // mux ratio
    write_cmd(0x3F);       // 64
    write_cmd(0xD3);       // display offset
    write_cmd(0x00);
    write_cmd(0x40);       // display start line
    write_cmd(0xAD);       // master configuration
    write_cmd(0x8B);       // DC-DC ON
    write_cmd(0xA1);       // segment remap (左右镜像)
    write_cmd(0xC8);       // COM scan direction (上下翻转)
    write_cmd(0xDA);       // COM pins
    write_cmd(0x12);
    write_cmd(0x81);       // contrast
    write_cmd(0x80);
    write_cmd(0xD9);       // pre-charge
    write_cmd(0x1F);
    write_cmd(0xDB);       // vcomh
    write_cmd(0x40);
    write_cmd(0xA4);       // display all on resume
    write_cmd(0xA6);       // normal display (not inverted)
    write_cmd(0x2E);       // deactivate scroll
    write_cmd(0xAF);       // display ON

    vTaskDelay(pdMS_TO_TICKS(20));

    /* 清屏 */
    display_clear();
    ESP_LOGI(TAG, "SH1106 init OK");
    return ESP_OK;
}

/* ========== 清屏 ========== */

void display_clear(void)
{
    memset(s_framebuf, 0, sizeof(s_framebuf));
    display_flush();
}

/* ========== 将帧缓冲区刷到显示屏 ========== */

void display_flush(void)
{
    if (!s_dev) return;

    for (int page = 0; page < PAGES; page++) {
        /* SH1106 列地址设置（低+高 nibble） */
        uint8_t col_low = 2 & 0x0F;          /* 偏移 2 列（SH1106 是 132 列，128 居中） */
        uint8_t col_high = (2 >> 4) | 0x10;
        write_cmd(0xB0 | page);              /* 设置页 */
        write_cmd(col_low);                   /* 列低 4 位 */
        write_cmd(col_high);                  /* 列高 4 位 */

        /* 发送该页 128 字节数据 */
        write_data(s_framebuf + page * WIDTH, WIDTH);
    }
}

/* ========== 绘制一个 8x8 字符到帧缓冲区 ========== */

static void draw_char_fb(int x, int y, char c)
{
    if (c < ' ' || c > 'z') return;
    if (x + 8 > WIDTH || y + 8 > HEIGHT) return;
    const uint8_t *ch = s_font8x8[c - ' '];
    int page = y / 8;
    int offset = y % 8;
    for (int col = 0; col < 8; col++) {
        if (page < PAGES)
            s_framebuf[page * WIDTH + x + col] |= ch[col] << offset;
        if (offset && page + 1 < PAGES)
            s_framebuf[(page + 1) * WIDTH + x + col] |= ch[col] >> (8 - offset);
    }
}

/* ========== 显示文本 ========== */

void display_print(int x, int y, const char *text)
{
    if (!text) return;
    int px = x;
    while (*text) {
        draw_char_fb(px, y, *text);
        px += 8;
        if (px + 8 > WIDTH) break;
        text++;
    }
}

/* ========== 显示两行状态 ========== */

/* ========== 显示表情 ========== */

void display_face(int x, int y, face_expr_t expr)
{
    if (expr < 0 || expr >= 5) return;
    const uint8_t *data = s_faces[expr];

    for (int page = 0; page < FACE_H / 8; page++) {
        for (int col = 0; col < FACE_W; col++) {
            int fb_x = x + col;
            int fb_y_page = page + y / 8;
            if (fb_x >= WIDTH || fb_y_page >= PAGES) continue;
            s_framebuf[fb_y_page * WIDTH + fb_x] = data[page * FACE_W + col];
        }
    }
    display_flush();
}

/* ========== 显示大表情（64x64，自动居中） ========== */

void display_face_big(bigface_expr_t expr)
{
    if (expr < 0 || expr >= 5) return;
    /* 满屏 128x64，直接拷贝 */
    const uint8_t *data = s_bigfaces[expr];
    memcpy(s_framebuf, data, sizeof(s_framebuf));
    display_flush();
}

/* ========== 显示两行状态 ========== */

void display_status(const char *line1, const char *line2)
{
    memset(s_framebuf, 0, sizeof(s_framebuf));
    if (line1) display_print(0, 0, line1);
    if (line2) display_print(0, 16, line2);
    display_flush();
}
