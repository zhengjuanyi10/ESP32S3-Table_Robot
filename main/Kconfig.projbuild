## main/Kconfig.projbuild
```kconfig
menu "Table Robot"

config TABLE_ROBOT_SERVO_ENABLE
    bool "Enable ZP bus-servo broadcast control"
    default y
    help
        Enable the one-wire UART interface for Zhongling ZP bus servos.
        Centering can be initiated with the BOOT button or automatically at
        application startup, depending on the options below.

if TABLE_ROBOT_SERVO_ENABLE

config TABLE_ROBOT_SERVO_BAUD_RATE
    int "ZP bus-servo UART baud rate"
    range 9600 1000000
    default 115200
    help
        UART baud rate used between ESP32-S3 and ZLink. The debug console can
        temporarily switch between 115200 and 9600 with the baudtest command.

config TABLE_ROBOT_SERVO_TX_GPIO
    int "ZP bus-servo UART TX GPIO"
    range 0 48
    default 17
    help
        Connect this GPIO to the S (signal) line of the ZP servo bus.
        GPIO 17 matches the vendor's ESP32 example.

config TABLE_ROBOT_SERVO_RX_GPIO
    int "ZP bus-servo UART RX GPIO"
    range 0 48
    default 16
    help
        Connect this GPIO to the TX pin of Zhongling's one-wire-to-two-wire
        UART adapter when angle or status readback is needed. GPIO 16 matches
        the vendor's ESP32 example.

config TABLE_ROBOT_SERVO_BUTTON_GPIO
    int "Servo-center button GPIO"
    range 0 48
    default 0
    help
        GPIO 0 is the BOOT button on ESP32-S3-DevKitC-1. Hold it after boot
        to intentionally send the broadcast center command.

config TABLE_ROBOT_SERVO_CENTER_PWM
    int "ZP servo center position (PWM)"
    range 500 2500
    default 1500
    help
        The ZP protocol center position is normally 1500. Confirm that this
        position is mechanically safe for the assembled robot before use.

config TABLE_ROBOT_SERVO_CENTER_TIME_MS
    int "Time for all servos to reach center (ms)"
    range 100 9999
    default 5000
    help
        A longer move is gentler on the mechanism. The ZP protocol accepts
        values from 0 to 9999 milliseconds.

config TABLE_ROBOT_SERVO_CENTER_HOLD_MS
    int "Required button hold time (ms)"
    range 500 10000
    default 1500
    help
        Requiring a long press prevents a normal reboot from moving the robot.

config TABLE_ROBOT_SERVO_AUTO_CENTER_ON_BOOT
    bool "Center all ZP servos automatically after boot"
    default n
    help
        Send the broadcast center command every time the application starts.
        Disable this option if the robot must remain still after a reset.

if TABLE_ROBOT_SERVO_AUTO_CENTER_ON_BOOT

config TABLE_ROBOT_SERVO_AUTO_CENTER_DELAY_MS
    int "Delay before automatic center (ms)"
    range 0 10000
    default 2000
    help
        Give the power supply and servo bus time to stabilize before the
        broadcast center command is sent.

endif

config TABLE_ROBOT_SERVO_VERIFY_CENTER_AFTER_MOVE
    bool "Verify servo positions after a broadcast center command"
    default n
    help
        Read each configured servo after it has had time to reach the center.
        Requires the RX path from the ZP UART adapter to GPIO16.

if TABLE_ROBOT_SERVO_VERIFY_CENTER_AFTER_MOVE

config TABLE_ROBOT_SERVO_VERIFY_TOLERANCE_PWM
    int "Allowed center error (PWM units)"
    range 0 500
    default 40
    help
        Center is considered successful when the readback is within this
        distance from the configured center PWM value.

endif

endif

menu "ILI9488 display"

config TABLE_ROBOT_DISPLAY_GPIO_DELAY_US
    int "ILI9488 GPIO clock half-cycle delay (us)"
    range 0 5
    default 0
    help
        Extra delay between GPIO clock edges. Use 0 for the fastest UI draw.
        Set this to 1 only when long or noisy jumper wires require the slower
        waveform that was used during initial panel bring-up.

config TABLE_ROBOT_DISPLAY_SCLK_GPIO
    int "ILI9488 SCLK GPIO"
    range 0 48
    default 4

config TABLE_ROBOT_DISPLAY_MOSI_GPIO
    int "ILI9488 MOSI GPIO"
    range 0 48
    default 5

config TABLE_ROBOT_DISPLAY_CS_GPIO
    int "ILI9488 CS GPIO"
    range 0 48
    default 6

config TABLE_ROBOT_DISPLAY_DC_GPIO
    int "ILI9488 DC GPIO"
    range 0 48
    default 7
    help
        GPIO47 is a 1.8 V pin on ESP32-S3R16V and cannot directly drive the
        3.3 V LCD logic. GPIO7 is a normal 3.3 V GPIO released by replacing
        the parallel OV5640 camera with an I2C-only vision module.

config TABLE_ROBOT_DISPLAY_RESET_GPIO
    int "ILI9488 RESET GPIO"
    range 0 48
    default 10
    help
        GPIO48 is a 1.8 V pin on ESP32-S3R16V and cannot reliably release the
        3.3 V LCD from reset. Connect the LCD reset signal to GPIO10.

config TABLE_ROBOT_DISPLAY_BACKLIGHT_GPIO
    int "ILI9488 backlight GPIO"
    range -1 48
    default 11
    help
        GPIO11 controls an external transistor/MOSFET backlight driver. Do not
        use the GPIO to source the LCD backlight current directly. GPIO38
        drives the onboard RGB LED on DevKitC-1 v1.1 and is not used.

config TABLE_ROBOT_DISPLAY_BRIGHTNESS_PERCENT
    int "ILI9488 default backlight brightness (%)"
    range 1 100
    default 40
    help
        PWM brightness used when the backlight is enabled. The backlight GPIO
        must control an external transistor or MOSFET, not the LED directly.

endmenu

menu "Capacitive touch"

config TABLE_ROBOT_TOUCH_ENABLE
    bool "Enable capacitive touch driver"
    default y
    help
        Enable the capacitive touch driver behind the TCA9548A I2C mux.
        When enabled, the touch panel is auto-detected at startup and
        polled periodically. Disable when no touch panel is connected
        to avoid I2C bus errors.

if TABLE_ROBOT_TOUCH_ENABLE

config TABLE_ROBOT_TOUCH_BYPASS_TCA
    bool "Bypass TCA9548A (touch directly on I2C bus)"
    default n
    help
        When enabled, the touch controller is probed directly on the I2C
        bus without going through the TCA9548A mux. Use this when the TCA
        chip is not installed or not responding, and the touch panel's
        SDA/SCL are connected directly to GPIO8/GPIO9.

config TABLE_ROBOT_TOUCH_TCA_CHANNEL
    int "Touch TCA9548A channel (0-7)"
    range 0 7
    default 1
    help
        The TCA9548A multiplexer channel that the capacitive touch
        controller is connected to. Channel 1 on this robot.

config TABLE_ROBOT_TOUCH_TCA_ADDR
    hex "TCA9548A I2C address"
    range 0x70 0x77
    default 0x70
    help
        The 7-bit I2C address of the TCA9548A mux. 0x70 is the default
        when A0/A1/A2 are grounded.

config TABLE_ROBOT_TOUCH_RESET_GPIO
    int "Touch RESET GPIO"
    range -1 48
    default 12
    help
        GPIO connected to the capacitive touch RST pin. The driver
        pulses this pin low then high during initialization. Set to
        -1 to skip hardware reset.

config TABLE_ROBOT_TOUCH_INT_GPIO
    int "Touch INT GPIO"
    range -1 48
    default 13
    help
        GPIO connected to the capacitive touch INT pin. Currently
        polled as a digital input; interrupt-driven wake is not
        implemented.

config TABLE_ROBOT_TOUCH_I2C_FREQ_HZ
    int "Touch I2C bus frequency (Hz)"
    range 50000 400000
    default 100000
    help
        I2C clock frequency for the touch controller behind the TCA
        mux. 100 kHz is reliable for most capacitive touch chips.

config TABLE_ROBOT_TOUCH_FT6X36_ADDR
    hex "FT6x36 I2C address"
    default 0x38
    help
        Typical address for FT6236/FT6336 touch controllers.

config TABLE_ROBOT_TOUCH_GT911_ADDR_PRIMARY
    hex "GT911 primary I2C address"
    default 0x5D
    help
        GT911 address when the INT pin is configured for 0x5D/0x14
        address selection.

config TABLE_ROBOT_TOUCH_GT911_ADDR_SECONDARY
    hex "GT911 secondary I2C address"
    default 0x14
    help
        GT911 alternate address.

config TABLE_ROBOT_TOUCH_CST816_ADDR
    hex "CST816 I2C address"
    default 0x15
    help
        Typical address for CST816-series touch controllers.

config TABLE_ROBOT_TOUCH_SWAP_XY
    bool "Swap touch X and Y coordinates"
    default n
    help
        Swap the raw X and Y axes before applying inversion. Enable when
        the touch panel reports in landscape (480x320) but the display is
        portrait (320x480). This panel reports in portrait natively.

config TABLE_ROBOT_TOUCH_INVERT_X
    bool "Invert touch X axis"
    default n
    help
        Mirror the X coordinate (subtract from screen width - 1).

config TABLE_ROBOT_TOUCH_INVERT_Y
    bool "Invert touch Y axis"
    default n
    help
        Mirror the Y coordinate (subtract from screen height - 1).

config TABLE_ROBOT_TOUCH_POLL_PERIOD_MS
    int "Touch poll period (ms)"
    range 10 500
    default 50
    help
        Interval between touch sample reads in the main application
        loop. 50 ms provides 20 Hz update rate with moderate CPU
        overhead.

endif  # TABLE_ROBOT_TOUCH_ENABLE

endmenu

endmenu
```

## sdkconfig.defaults
```kconfig
# ESP32-S3-DevKitC-1-N32R16V
# 32 MB Octal flash + 16 MB Octal PSRAM, both at 1.8 V.

# External flash
CONFIG_ESPTOOLPY_OCT_FLASH=y
CONFIG_ESPTOOLPY_FLASHMODE_OPI=y
CONFIG_ESPTOOLPY_FLASH_SAMPLE_MODE_DTR=y
CONFIG_ESPTOOLPY_FLASHFREQ_80M=y
CONFIG_ESPTOOLPY_FLASHSIZE_32MB=y

# External PSRAM
CONFIG_SPIRAM=y
CONFIG_SPIRAM_MODE_OCT=y
CONFIG_SPIRAM_SPEED_80M=y
CONFIG_SPIRAM_USE_MALLOC=y
CONFIG_SPIRAM_MALLOC_ALWAYSINTERNAL=16384
CONFIG_SPIRAM_MALLOC_RESERVE_INTERNAL=32768
CONFIG_SPIRAM_MEMTEST=y
CONFIG_TABLE_ROBOT_DISPLAY_GPIO_DELAY_US=0
CONFIG_TABLE_ROBOT_DISPLAY_SCLK_GPIO=4
CONFIG_TABLE_ROBOT_DISPLAY_MOSI_GPIO=5
CONFIG_TABLE_ROBOT_DISPLAY_CS_GPIO=6
CONFIG_TABLE_ROBOT_DISPLAY_DC_GPIO=7
CONFIG_TABLE_ROBOT_DISPLAY_RESET_GPIO=10
CONFIG_TABLE_ROBOT_DISPLAY_BACKLIGHT_GPIO=11
CONFIG_TABLE_ROBOT_DISPLAY_BRIGHTNESS_PERCENT=40

# Capacitive touch (direct to GPIO8/GPIO9, GPIO12 RST, GPIO13 INT)
CONFIG_TABLE_ROBOT_TOUCH_ENABLE=y
CONFIG_TABLE_ROBOT_TOUCH_BYPASS_TCA=y
CONFIG_TABLE_ROBOT_TOUCH_TCA_CHANNEL=1
CONFIG_TABLE_ROBOT_TOUCH_TCA_ADDR=0x70
CONFIG_TABLE_ROBOT_TOUCH_RESET_GPIO=12
CONFIG_TABLE_ROBOT_TOUCH_INT_GPIO=13
CONFIG_TABLE_ROBOT_TOUCH_I2C_FREQ_HZ=50000
CONFIG_TABLE_ROBOT_TOUCH_FT6X36_ADDR=0x38
CONFIG_TABLE_ROBOT_TOUCH_GT911_ADDR_PRIMARY=0x5D
CONFIG_TABLE_ROBOT_TOUCH_GT911_ADDR_SECONDARY=0x14
CONFIG_TABLE_ROBOT_TOUCH_CST816_ADDR=0x15
# Touch reports in portrait natively — no swap or invert needed.
CONFIG_TABLE_ROBOT_TOUCH_SWAP_XY=n
CONFIG_TABLE_ROBOT_TOUCH_INVERT_X=n
CONFIG_TABLE_ROBOT_TOUCH_INVERT_Y=n
CONFIG_TABLE_ROBOT_TOUCH_POLL_PERIOD_MS=50
```
